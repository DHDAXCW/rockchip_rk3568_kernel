// SPDX-License-Identifier: (GPL-2.0+ OR MIT)
/*
 * Copyright (c) 2020 Rockchip Electronics Co., Ltd.
 *
 */

/dts-v1/;

#include "rk3568-photonicat.dtsi"
#include "rk3568-linux.dtsi"

/ {
	model = "Rockchip RK3568 photonicat Linux Board";
	compatible = "rockchip,rk3568-photonicat", "rockchip,rk3568";
};

&rknpu {
	rknpu-supply = <&vdd_npu>;

	status = "disabled";
};

&rknpu_mmu {
	status = "disabled";
};

&gpu {
	interrupt-names = "job", "mmu", "gpu";
	clocks = <&scmi_clk 1>, <&cru CLK_GPU>;
	clock-names = "gpu", "bus";

	status = "okay";
};
