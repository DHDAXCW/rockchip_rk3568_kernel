// SPDX-License-Identifier: (GPL-2.0+ OR MIT)
/*
 * Copyright (c) 2020 Rockchip Electronics Co., Ltd.
 *
 */

/dts-v1/;

#include "rk3568-langji-tablet.dtsi"
#include "rk3568-linux.dtsi"

/ {
	model = "Rockchip RK3568 LangJi Tablet Linux Board";
	compatible = "rockchip,rk3568-langji-tablet", "rockchip,rk3568";

        chosen: chosen {
                bootargs = "earlycon=uart8250,mmio32,0xfe660000 console=ttyFIQ0 rootfstype=ext4 rw rootwait coherent_pool=1m systemd.gpt_auto=0 cgroup_enable=memory swapaccount=1 consoleblank=0 video=eDP-1:e";
                /* mmcblk0p6: eMMC rootfs, mmcblk1p1: SD rootfs */
        };

};

&rknpu {
	rknpu-supply = <&vdd_npu>;

	status = "okay";
};

&rknpu_mmu {
	status = "okay";
};

